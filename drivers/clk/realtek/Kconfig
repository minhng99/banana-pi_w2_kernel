## drivers/clk/realtek/Kconfig
```kconfig
config COMMON_CLK_REALTEK
	bool "Clock driver for realtek"
	select RTK_MMIO 
	select RESET_CONTROLLER

config COMMON_CLK_REALTEK_DEBUG
	bool "Clock debug"
	select RTK_REGISTER_TRACKER
	default y
	help
	  Add a simple register tracker to clock
```

## drivers/media/platform/rtk_cec/Kconfig
```kconfig
#Copyright (C) 2007-2013 Realtek Semiconductor Corporation.
# drivers/Kconfig

menu "CEC Support"

config CEC
	bool "CEC Support"

menu "CEC Adapters"
	depends on CEC

config RTK_CEC
	tristate "CEC Controller for Realtek platform"
	depends on CEC
	default n
	help
	  Say Y, if you want to enable CEC feature on Realtek platform.

endmenu
endmenu
```

## drivers/pinctrl/realtek/Kconfig
```kconfig
config PINCTRL_RTD129x
	bool "RTD129x pin controller driver"
	depends on ARCH_RTD129x
	default y
	select PINMUX
	select GENERIC_PINCONF
```

## drivers/soc/realtek/Kconfig
```kconfig
config RTD129x
	bool "Realtek RTD129x SoC family specific drivers"
	depends on ARCH_RTD129x
	default y
	help
	  Realtek RTD129x SoC family specific support.

	  If unsure, say N.

if RTD129x
source "drivers/soc/realtek/rtd129x/Kconfig"
source "drivers/soc/realtek/common/Kconfig"
endif # RTD129x
```

## drivers/thermal/realtek/Kconfig
```kconfig
config RTK_THERMAL
	bool "Realtek thermal management"
	depends on OF && THERMAL_OF
	help
	  Enable thermal management with a generic thermal
	  sensor driver on Realtek SoCs.

	  If you want this support, you should say Y here.

config RTK_THERMAL_RTD129X
	bool "RTD-129x thermal sensor support"
	default y if ARCH_RTD129x
	select RTK_THERMAL
```
